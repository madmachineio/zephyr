## boards/arm/mm_feather/Kconfig.board
```kconfig
#
# Copyright (c) 2019, MADMACHINE LIMITED
#
# SPDX-License-Identifier: Apache-2.0
#

config BOARD_MM_FEATHER
	bool "MM MM-FEATHER"
	depends on SOC_SERIES_IMX_RT
	select SOC_PART_NUMBER_MIMXRT1062DVL6A
```

## boards/madmachine/mm_micro/board.yml
```yaml
board:
  name: mm_micro
  vendor: madmachine
  revision:
    format: "custom"
    default: "basic"
    revisions:
      - name: "basic"
      - name: "swiftio"
      - name: "playground"
  socs:
    - name: mimxrt1062
```

## boards/madmachine/mm_micro/mm_micro_mimxrt1062_swiftio_defconfig
```kconfig
#
# Copyright (c) 2021, MADMACHINE LIMITED
#
# SPDX-License-Identifier: Apache-2.0
#

CONFIG_HW_STACK_PROTECTION=n
CONFIG_MPU=n
CONFIG_ARM_MPU=n
CONFIG_NXP_IMXRT_BOOT_HEADER=n
CONFIG_ROM_START_OFFSET=0
CONFIG_XIP=n
CONFIG_FLASH_SIZE=16384
CONFIG_FLASH_BASE_ADDRESS=0x60000000
```

## drivers/kscan/Kconfig.gt9x
```kconfig
# Copyright (c) 2020 Frank
# SPDX-License-Identifier: Apache-2.0

menuconfig KSCAN_GT9X
	bool "GT91X capacitive touch panel driver"
	depends on I2C && HAS_DTS_I2C
	help
	  Enable driver for the GT91X capacitive touch panel controller.

config KSCAN_GT9X_PERIOD
	int "Sample period (ms)"
	default 10
	depends on KSCAN_GT9X

config KSCAN_GT9X_INTERRUPT
	bool "Enable interrupt"
	depends on KSCAN_GT9X
```

## dts/bindings/display/lcd,rgb-interface.yaml
```yaml
# Copyright (c) 2020, MADMACHINE LIMITED
# SPDX-License-Identifier: Apache-2.0

description: LCD module with LED backlight and RGB Interface

compatible: "lcd,rgb-interface"

properties:
    width:
      type: int
      required: true
      description: lcd panel width
    height:
      type: int
      required: true
      description: lcd panel height
    hsw:
      type: int
      required: true
      description: HSYNC pulse width
    hfp:
      type: int
      required: true
      description: HSD front porch
    hbp:
      type: int
      required: true
      description: HSD back porch
    vsw:
      type: int
      required: true
      description: VSYNC pulse width
    vfp:
      type: int
      required: true
      description: VSD front porch
    vbp:
      type: int
      required: true
      description: VSD back porch
    frame-per-sec:
      type: int
      required: false
      description: frame rate

include: base.yaml
```

## dts/bindings/kscan/coodix,gt9x.yaml
```yaml
# Copyright (c) 2020 Frank
# SPDX-License-Identifier: Apache-2.0

description: GT9x capacitive touch panel

compatible: "coodix,gt9x"

include: [kscan.yaml, i2c-device.yaml]

properties:
    width:
      type: int
      required: true
      description: touch panel width
    height:
      type: int
      required: true
      description: touch panel height
    int-gpios:
      type: phandle-array
      required: false
    reset-gpios:
      type: phandle-array
      required: false
```
